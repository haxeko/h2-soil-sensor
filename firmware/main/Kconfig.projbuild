## firmware/main/Kconfig.projbuild
```kconfig
menu "H2 Soil Sensor"

    menu "Measurement & reporting"
        config SOIL_MEAS_PERIOD_S
            int "Measurement period (s)"
            range 30 86400
            default 900
            help
                Time between two measurements. 900 s = 15 min. Can be overridden at run time
                (value stored in NVS key "period_s").

        config SOIL_MAX_REPORT_INTERVAL_S
            int "Maximum interval between attribute updates (s)"
            range 60 86400
            default 3600
            help
                A value is pushed to the Matter data model when it changed by more than its
                threshold OR when this time elapsed since the last update.

        config SOIL_REPORT_DELTA_PCT
            int "Soil moisture report threshold (%)"
            range 0 50
            default 2

        config VBAT_REPORT_DELTA_MV
            int "Battery voltage report threshold (mV)"
            range 0 500
            default 30

        config SOIL_SETTLE_MS
            int "Soil module settling time after VSENS on (ms)"
            range 50 10000
            default 1500
            help
                Capacitive soil modules (v1.2/v2.0, DFRobot SEN0193 and clones) need about 1 s
                after power-up before AOUT is stable (oscillator + peak detector / RC output).
                The SoC light-sleeps during this time; the module itself draws ~5 mA.

        config SOIL_MODULE_MIN_MV
            int "AOUT below this value = soil module missing (mV)"
            range 0 1000
            default 200

        config SOIL_ADC_SAMPLES
            int "ADC samples per channel (averaged, trimmed mean)"
            range 8 512
            default 64
    endmenu

    menu "Calibration"
        config SOIL_CAL_DRY_MV_DEFAULT
            int "Default DRY point (mV at AOUT, module in air)"
            default 2500
            help
                The capacitive module v1.2 at 3.3 V typically gives ~2.2-2.8 V in air and
                ~1.0-1.4 V in water. Calibrate every module with the button (double click = dry,
                triple click = wet); the values are stored in NVS.

        config SOIL_CAL_WET_MV_DEFAULT
            int "Default WET point (mV at AOUT, module in water)"
            default 1200

    endmenu

    menu "Hardware options"

        config SOIL_ENABLE_RH_MIRROR
            bool "Expose soil moisture also as a Humidity Sensor endpoint (Apple/Google compatibility)"
            default y

        config VSENS_SOFTSTART_US
            int "VSENS soft-start time (us, 0 = hard switch)"
            range 0 20000
            default 1000
            help
                Q4 is first turned on through the weak internal pull-down only, which limits the
                inrush current into the sensor-module capacitors (keeps +3V3 from dipping).

        config VBAT_DIVIDER_RATIO_X1000
            int "Battery divider ratio x1000 (R7+R8)/R8"
            default 2000

        config VBAT_SHUTDOWN_MV
            int "Battery cut-off: below this the device shuts down (mV, 0 = never)"
            default 2050

        config THREAD_TX_POWER_DBM
            int "802.15.4 TX power (dBm)"
            range -24 20
            default 10
            help
                ESP32-H2 draws ~140 mA at +20 dBm and ~60 mA at +9 dBm. +10 dBm is a good
                compromise for an outdoor sensor near a Thread router.
    endmenu

    menu "GPIO map (ESP32-H2-WROOM-02C)"
        config GPIO_SOIL_ADC
            int "SOIL_ADC (ADC1, soil module AOUT via 1k)"
            default 1
        config GPIO_VBAT_ADC
            int "VBAT_ADC (ADC1)"
            default 2
        config GPIO_SENS_PWR_EN_N
            int "SENS_PWR_EN_N (low = VSENS on)"
            default 10
        config GPIO_VBAT_MEAS_EN
            int "VBAT_MEAS_EN (high = divider on)"
            default 11
        config GPIO_LED
            int "Status LED (active high)"
            default 0
        config GPIO_BUTTON
            int "BOOT/USER button (active low, LP GPIO for wake-up)"
            range 8 14
            default 9
    endmenu

endmenu
```
